const byte porteAvion[] PROGMEM = {64,47,0x0,0x0,0x20,0x0,0x0,0x0,0x0,0x0,0x0,0x0,0x2C,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0x0,};
const byte porteAvion2[] PROGMEM = {88,56,0x0,0x0,0x0,0x0,0x40,0x0,0x0,0x0,0x0,0x0,0x0,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0x0,};


void initPorteAvion()
{

}

void updatePorteAvion()
{

}


void drawPorteAvion()
{
    byte coordx= PORTEAVION_XWORLD - player.x_world;
    byte coordy= PORTEAVION_YWORLD - player.y_world;

    if( player.x_world>154 && player.x_world<315 && player.y_world>230 && player.y_world<334){
      gb.display.drawBitmap(coordx,coordy,porteAvion2);
    }
}


//##################################################################
//##################################################################
void fnctn_checkLanding() {
  
  //241, 274
  if (player.x_world > (HELIPORT_XWORLD - SCREEN_HALF_WIDTH)   && player.x_world < (HELIPORT_XWORLD - SCREEN_HALF_WIDTH) + 8     && player.y_world > (HELIPORT_YWORLD - SCREEN_HALF_HEIGHT -6)     && player.y_world < (HELIPORT_YWORLD - SCREEN_HALF_HEIGHT -6) + 8)
  {
    if (player.vSpeed == 0    && player.hSpeed == 0   && player.isLanding == 0) {
      if (player.life < MAXLIFE - 1 || player.fuel < MAXFUEL - 1) {
              player.isLanding = 1;
      }
    } else  if (player.isLanding == 1 && player.altitude == 0) {
      
        if (convoiSecuriser) {
            endGameOK();
        } else {
          if (player.life == MAXLIFE && player.fuel == MAXFUEL) {
            player.isLanding = 0;
          }
          else {
            if (player.life < MAXLIFE) {
              player.life++;
            } if (player.fuel < MAXFUEL) {
              player.fuel++;
            }
            if (player.life == MAXLIFE && player.fuel == MAXFUEL) {
              if (money < 1000) {
                money = 0;
              } else {
                money = money - 800;
              }
            }
          }

        }
      }
  }
}

