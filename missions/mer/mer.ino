#include <SPI.h>
#include <Gamebuino.h>
Gamebuino gb;
const byte avionChasse[] PROGMEM = {32,18,0x0,0x0,0xE0,0xC0,0x0,0x1,0x61,0xC0,0x0,0x6,0xC3,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0xF8,};
const byte petitBateau[] PROGMEM = {24,17,0x0,0x2,0x0,0x0,0x5,0x0,0x0,0xD,0x80,0xC0,0xA,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0x0,};
const byte petitBateauB[] PROGMEM = {24,17,0x0,0x0,0x0,0x7,0xFE,0x0,0x15,0xA,0x0,0x15,0xFA,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0x0,};
const byte petitBateauBD[] PROGMEM = {24,17,0x1,0x80,0x0,0x24,0x80,0x0,0x36,0x80,0x0,0x12,0x60,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0x0,};
const byte petitBateauBG[] PROGMEM = {24,17,0x0,0x18,0x0,0x0,0x12,0x40,0x0,0x16,0xC0,0x0,0x64,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0x0,};
const byte petitBateauD[] PROGMEM = {24,17,0x4,0x0,0x0,0xA,0x0,0x0,0x1B,0x0,0x0,0x25,0x0,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0x0,};
const byte petitBateauH[] PROGMEM = {24,17,0x0,0x78,0x0,0x9,0xE9,0x0,0x13,0x2C,0x80,0x25,0x3A,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0x80,};
const byte petitBateauHD[] PROGMEM = {24,17,0x0,0x1E,0x0,0x0,0x33,0x80,0x0,0x21,0xC0,0x0,0x61,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0x0,};
const byte petitBateauHG[] PROGMEM = {24,17,0x7,0x80,0x0,0x1C,0xC0,0x0,0x38,0x40,0x0,0x68,0x60,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0x0,};

const byte sousMarin[] PROGMEM = {24,18,0x70,0x0,0x0,0x70,0x0,0x0,0x30,0x0,0x0,0x30,0x0,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0x0,};
const byte sousMarinB[] PROGMEM = {24,18,0x0,0xC0,0x0,0x1,0xE0,0x0,0x1,0xE0,0x0,0x11,0x20,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0x0,};
const byte sousMarinBD[] PROGMEM = {24,18,0x6,0x0,0x0,0xF,0x0,0x0,0xB,0x0,0x0,0xB,0x0,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0x0,};
const byte sousMarinBG[] PROGMEM = {24,18,0x0,0xC,0x0,0x0,0x1E,0x0,0x0,0x1A,0x0,0x0,0x1A,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0x0,};
const byte sousMarinD[] PROGMEM = {24,18,0x0,0x1,0xC0,0x0,0x1,0xC0,0x0,0x1,0x80,0x0,0x1,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0x80,};
const byte sousMarinH[] PROGMEM = {24,18,0x0,0xC0,0x0,0x1,0xE0,0x0,0x1,0xE0,0x0,0x1,0xE0,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0x0,};
const byte sousMarinHD[] PROGMEM = {24,18,0x0,0xC,0x0,0x0,0x1E,0x0,0x0,0x1C,0x0,0x0,0x1E,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0x0,};
const byte sousMarinHG[] PROGMEM = {24,18,0x6,0x0,0x0,0xF,0x0,0x0,0x7,0x0,0x0,0xF,0x0,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0x0,};
const byte torpilleAir[] PROGMEM = {16,6,0x0,0x0,0x0,0x0,0x0,0x0,0x1F,0xC0,0x20,0x40,0x1F,0xC0,};
const byte torpilleEau[] PROGMEM = {16,7,0x30,0x0,0x40,0xC0,0x81,0x8,0x3E,0x11,0x81,0x8,0x40,0xC0,0x30,0x0,};
const byte torpillePlouf[] PROGMEM = {16,6,0x48,0x0,0x1,0x20,0x89,0x40,0x40,0x0,0x35,0x60,0xA,0x80,};


#define NB_SEC_TO_WIN 700
uint16_t timerToWin=NB_SEC_TO_WIN;

#define PORTEAVION_XWORLD 239
#define PORTEAVION_YWORLD 278

#define HELIPORT_XWORLD 279
#define HELIPORT_YWORLD 302

#define NAME_MENU "CS"

#define GAME 2

#define SCREENWIDTH 84
#define SCREENHEIGHT 48

#define SCREEN_HALF_WIDTH 42
#define SCREEN_HALF_HEIGHT 24

#define VERTALIGNMENT 10
#define LEVELWIDTH 630
#define LEVELHEIGHT 630
#define SPRITESIZE 125

#define MAXALTITUDE 8
#define MAXFUEL 30
#define MAXLIFE 50
#define MAXBULLET 10

#define TMPUNIT 20
#define TMPTANK 40
#define TMPTOUR 20
#define TMPBUNKER 10
#define TMPRESURECTION 200
#define WAIT_TIME 240

extern const byte HUD[];

extern const byte helix[4][8];
extern const byte impact[3][10];
extern const byte boom[12][13];

extern const byte copterShadow[];
extern const byte copterProfile[];
extern const byte copterProfile_mask[];
extern const byte copterDiag1[];
extern const byte copterDiag1_mask[];
extern const byte copterDiag2[];
extern const byte copterDiag2_mask[];
extern const byte copterDown[];
extern const byte copterUp[];
extern const byte copterUpDown_mask[];

extern const byte Ennemy_Unit[];

extern const byte* sprites[];
extern const byte* destroy[];
extern const byte* tank[];
extern const byte* spriteBkg[];

//Struct
typedef struct{
  int  x_world;
  int  y_world;
  char dir;
  char vSpeed;
  char hSpeed;
  byte altitude;
  byte isLanding;
  byte fire;
  byte fuel;
  byte fuelCheck;
  byte life;
  byte isCrashing;
  byte animHelix;
  byte animBoom;
  byte animDamage;
  byte moveMode;
} Player;

typedef struct{
  byte shooter;
  int x_world;
  int y_world;
  byte dir;
  byte distance;
} Bullet;

typedef struct{
  int x_world;
  int y_world;
  byte width;
  byte height;
  byte sprite;
  byte life; 
  byte animBoom;
  byte fireTimer;
} Hostile;

typedef struct{
  int x_world;
  int y_world;
  byte width;
  byte height;
  byte sprite;
  byte life; 
  byte animBoom;
  byte fireTimer;
  byte dir;
  byte batiment;
} HostileMobile;

typedef struct{
  int x_world;
  int y_world;
  byte width;
  byte height;
  byte sprite;
  byte life; 
  byte animBoom;
} Object;

typedef struct{
  int x_world;
  int y_world;
  byte width;
  byte height;
  byte sprite;
} Friend;

typedef struct{
  int x_world;
  int y_world;
  byte sprite;
} Bkgrnd;

Player        player;
Friend        bkgrnd[15];
Bkgrnd        bkg[19];
Object        building_friend[9];
Hostile       building_hostile[21];
HostileMobile mobilUnit_hostile[20];
Bullet        bullet[MAXBULLET];

#define NB_FRAME_EXPLOSION 7
#define TEMP_EXPOLOSION 35
byte cptExplosion = 0;
//const byte * explosion[NB_FRAME_EXPLOSION] = {ex1,ex2,ex3,ex4,ex5,ex6,ex7};

//Global Variables
byte i;
byte j;
byte check01;
byte check02;
byte cptAnim;
byte gameStatus;
//byte lvl;
//byte difficulty;
int money;
byte destroyedBuildings;
int coordx;
int coordy;
byte width;
byte height;
byte nbHeliport;
byte nbBuilding_Hostile;
byte nbBuilding_Friend;
boolean convoiSecuriser = false;
byte wait_time;


//global methode
uint8_t getNext();


//#####################################################
//#####################################################
void setup() {
  gb.begin();
  intialiseMap();
}
void intialiseMap()
{
  gameStatus = GAME;
  money=0;
  cptAnim=0;
  gb.battery.show=false;
  fnctn_initLevel();
  fnctn_initPlayer();
  initPorteAvion();
  initWorld();
}


//#####################################################
//#####################################################
void loop() {
  if(gb.update()){ 
    
      if(gb.buttons.pressed(BTN_C)){
        returnToMenu();
      }
      updateWorld();
      updatePorteAvion();
      
      drawWorld();
      drawPorteAvion();

      //draw baseCamps          (Base, fuel, garage, heliport)
      //outpt_drawbaseCamps();
      
      //draw friendBuildings  (Village, Camps) 
      //outpt_drawBuilding_Friend();
      //draw hostileBuildings (Tour, Bunker) & Mobiles(Units, Tank)
      //outpt_drawBuilding_Hostile();
      //outpt_drawMobile_Hostile();

      //draw background         (tree, bush, sand, rocks)
      //outpt_drawBackground();
      
      //draw player & ennemy Fire
      outpt_drawPlayerFire();
      outpt_drawEnnemyFire();
      
      //draw HUD + Player
      outpt_drawHUD();
      outpt_drawPlayer();
      
      
      //draw animBoom
      outpt_animBoom();

      //outpt_GameOver
      outpt_GameOver();

      
      //checks
      fnctn_checkLanding();
      fnctn_checkButtons();
      fnctn_checkPlayerAltitude();
      //fnctn_checkPlayerFire();
      //fnctn_checkEnnemyFire();
      //fnctn_checkFuel();
  
      //Timers
      //fnctn_initEnnemyFire();
      fnctn_animation();
      //fnctn_resurection();
  }
}


void endGameOK(){
  while(true){
    if(gb.update()){
     //gb.display.drawBitmap(0,0,FinalScreen);
     
      if(gb.buttons.pressed(BTN_C)){
        intialiseMap();
        return;  
      }
      if(gb.buttons.pressed(BTN_A) || gb.buttons.pressed(BTN_B)){
        gb.display.clear();
//        gb.display.drawBitmap(0,0,loading);
        gb.display.update();
        load_game(NAME_MENU);
      }
    }
  }
}

void returnToMenu()
{
  while(true){
    if(gb.update()){
      gb.display.println("Are you sur to return "); 
      gb.display.println("To Game menu?");
      gb.display.println("Press \25 to quit");
      gb.display.println("Press \27 to restart");
      
      if(gb.buttons.pressed(BTN_C)){
        intialiseMap();
        return;  
      }
      if(gb.buttons.pressed(BTN_A)){
        gb.display.clear();
        gb.display.println("Extraction ...");
        gb.display.println("Please Wait"); 
        gb.display.update();
        load_game(NAME_MENU);
      }
      if(gb.buttons.pressed(BTN_B)){
        break;
      }
    }
  }
}
